#include <Arduino.h>
#include <U8g2lib.h> // u8g2 library is used to draw graphics on the OLED display

extern U8G2_SSD1306_128X64_NONAME_F_HW_I2C u8g2;

const int numberOfItems = 9; // number of items in the menu
extern RTC_DATA_ATTR int currentItemIndex;
extern int previousItemIndex;
extern int nextItemIndex;

#pragma region "Icons"
// ' SelectBorder', 128x21px
static const unsigned char image_Select_bits[] U8X8_PROGMEM =  {0xff,0xff,0xff,0xff,0xff,0xff,0xff,0xff,0x2a,0x33,0xc6,0x70,0x00,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0x7f,0x00};
// ' BackArrowIcon', 16x16px
const unsigned char epd_bitmap__BackArrowIcon[] PROGMEM = {
    0x00, 0x00, 0x00, 0x30, 0x00, 0x70, 0x00, 0xf0, 0x01, 0xf0, 0x03, 0xe0, 0x07, 0xc0, 0x0f, 0x80,
    0x07, 0xc0, 0x03, 0xe0, 0x01, 0xf0, 0x00, 0xf0, 0x00, 0x70, 0x00, 0x30, 0x00, 0x00, 0x00, 0x00};
// ' CompassIcon', 16x16px
const unsigned char epd_bitmap__CompassIcon[] PROGMEM = {
    0x00, 0x00, 0x03, 0xc0, 0x1c, 0x38, 0x31, 0x8c, 0x20, 0x14, 0x40, 0x22, 0x40, 0x42, 0x51, 0x8a,
    0x50, 0x8a, 0x40, 0x02, 0x40, 0x02, 0x20, 0x04, 0x31, 0x8c, 0x1c, 0x38, 0x03, 0xc0, 0x00, 0x00};
// ' icon', 16x16px
const unsigned char epd_bitmap__icon[] PROGMEM = {
    0x00, 0x00, 0x00, 0x00, 0x01, 0x80, 0x03, 0xc0, 0x07, 0xe0, 0x01, 0x80, 0x11, 0x88, 0x31, 0x8c,
    0x7f, 0xfe, 0x31, 0x8c, 0x11, 0x88, 0x01, 0x80, 0x07, 0xe0, 0x03, 0xc0, 0x01, 0x80, 0x00, 0x00};
const unsigned char epd_bitmap__LaptopIcon[] PROGMEM = {
    0x00, 0x00, 0x00, 0x00, 0x00, 0x00, 0x00, 0x00, 0x0f, 0xf0, 0x10, 0x08, 0x10, 0x08, 0x10, 0x08,
    0x10, 0x08, 0x1f, 0xf8, 0x2a, 0xac, 0x55, 0x52, 0x7f, 0xfe, 0x00, 0x00, 0x00, 0x00, 0x00, 0x00};
// ' icon', 16x16px
const unsigned char epd_bitmap__Settings[] PROGMEM = {
    0x00, 0x00, 0x00, 0x00, 0x0d, 0xb0, 0x1f, 0xf8, 0x3c, 0x3c, 0x38, 0x1c, 0x11, 0x88, 0x32, 0x4c,
    0x32, 0x4c, 0x11, 0x88, 0x38, 0x1c, 0x3c, 0x3c, 0x1f, 0xf8, 0x0d, 0xb0, 0x00, 0x00, 0x00, 0x00};
// ' ScrollHandle', 3x3px
const unsigned char epd_bitmap__ScrollHandle[] PROGMEM = {
    0xe0, 0xe0, 0xe0};

// ' clock', 16x16px
const unsigned char epd_bitmap__clock [] PROGMEM = {
	0x00, 0x00, 0x03, 0xc0, 0x06, 0x60, 0x01, 0x80, 0x07, 0xe0, 0x0c, 0x30, 0x19, 0x18, 0x10, 0x48, 
	0x30, 0x8c, 0x35, 0x2c, 0x10, 0x08, 0x19, 0x18, 0x0c, 0x30, 0x07, 0xe0, 0x01, 0x80, 0x00, 0x00
};

const unsigned char epd_bitmap__gamepad [] PROGMEM = {
	0x00, 0x00, 0x00, 0x00, 0x01, 0x80, 0x0f, 0xf0, 0x1f, 0xf8, 0x37, 0xfc, 0x63, 0xd6, 0x77, 0xfe, 
	0x7f, 0xfe, 0x7c, 0x3e, 0x78, 0x1e, 0x70, 0x0e, 0x00, 0x00, 0x00, 0x00, 0x00, 0x00, 0x00, 0x00
};

const unsigned char epd_bitmap__VersionICON [] PROGMEM = {
	0x00, 0x00, 0x00, 0x00, 0x0e, 0x00, 0x0a, 0x00, 0x0e, 0x70, 0x04, 0x50, 0x04, 0x70, 0x04, 0x20, 
	0x04, 0xe0, 0x07, 0x80, 0x04, 0x00, 0x0e, 0x00, 0x0a, 0x00, 0x0e, 0x00, 0x00, 0x00, 0x00, 0x00
};

const unsigned char *Icons[numberOfItems] = {
    epd_bitmap__BackArrowIcon,
    epd_bitmap__CompassIcon,
    epd_bitmap__icon,
    epd_bitmap__LaptopIcon,
    epd_bitmap__Settings,
    epd_bitmap__clock,
    epd_bitmap__gamepad,
	epd_bitmap__VersionICON,
	epd_bitmap__LaptopIcon,
};

const char Icon_Names[numberOfItems][20] = {
    "Back", "Compass", "Button Test", "PC Control", "Settings", "Clock", "Games", "Version", "Text Screen"};
#pragma endregion

#pragma region "MainMenuAnimation"
// '0001', 32x64px
const unsigned char mainMenuAnimation_0001 [] PROGMEM = {
	0xff, 0x3f, 0xc0, 0x00, 0xff, 0x9f, 0xe0, 0x00, 0xff, 0xcf, 0xf0, 0x00, 0xff, 0xe7, 0xf0, 0x00, 
	0xff, 0xf7, 0xf8, 0x00, 0x3f, 0xfb, 0xfc, 0x00, 0xdf, 0xfd, 0xfc, 0x00, 0xef, 0xfe, 0xfe, 0x00, 
	0xf7, 0xff, 0x7f, 0x00, 0xfb, 0xff, 0x3f, 0x00, 0xfd, 0xff, 0xbf, 0x80, 0xfe, 0xff, 0xdf, 0x80, 
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	0xff, 0xff, 0xf8, 0x00, 0xff, 0xf7, 0xf0, 0x00, 0xff, 0xef, 0xf0, 0x00, 0xff, 0xdf, 0xe0, 0x00
};
// '0002', 32x64px
const unsigned char mainMenuAnimation_0002 [] PROGMEM = {
	0xff, 0x3f, 0xc0, 0x00, 0xff, 0x9f, 0xe0, 0x00, 0xff, 0xcf, 0xf0, 0x00, 0xff, 0xe7, 0xf0, 0x00, 
	0xff, 0xf7, 0xf8, 0x00, 0x3f, 0xfb, 0xfc, 0x00, 0x1f, 0xfd, 0xfc, 0x00, 0xef, 0xfe, 0xfe, 0x00, 
	0xf7, 0xff, 0x7f, 0x00, 0xfb, 0xff, 0x3f, 0x00, 0xfd, 0xff, 0xbf, 0x80, 0xfe, 0xff, 0xdf, 0x80, 
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	0xff, 0xfb, 0xf8, 0x00, 0xff, 0xf7, 0xf8, 0x00, 0xff, 0xe7, 0xf0, 0x00, 0xff, 0xdf, 0xe0, 0x00
};
// '0003', 32x64px
const unsigned char mainMenuAnimation_0003 [] PROGMEM = {
	0xff, 0x3f, 0xc0, 0x00, 0xff, 0x9f, 0xe0, 0x00, 0xff, 0xcf, 0xf0, 0x00, 0xff, 0xe7, 0xf0, 0x00, 
	0xff, 0xf7, 0xf8, 0x00, 0x3f, 0xfb, 0xfc, 0x00, 0x1f, 0xfd, 0xfc, 0x00, 0x0f, 0xfe, 0xfe, 0x00, 
	0x07, 0xff, 0x7f, 0x00, 0x1b, 0xff, 0x3f, 0x00, 0x7d, 0xff, 0xbf, 0x80, 0xfe, 0xff, 0xdf, 0x80, 
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	0xff, 0xff, 0xf8, 0x00, 0xff, 0xf7, 0xf0, 0x00, 0xff, 0xef, 0xf0, 0x00, 0xff, 0xdf, 0xe0, 0x00
};
// '0004', 32x64px
const unsigned char mainMenuAnimation_0004 [] PROGMEM = {
	0xff, 0x3f, 0xc0, 0x00, 0xff, 0x9f, 0xe0, 0x00, 0xff, 0xcf, 0xf0, 0x00, 0xff, 0xe7, 0xf0, 0x00, 
	0xff, 0xf7, 0xf8, 0x00, 0x3f, 0xfb, 0xfc, 0x00, 0x1f, 0xfd, 0xfc, 0x00, 0x0f, 0xfe, 0xfe, 0x00, 
	0x07, 0xff, 0x7f, 0x00, 0x03, 0xff, 0x3f, 0x00, 0x01, 0xff, 0xbf, 0x80, 0x06, 0xff, 0xdf, 0x80, 
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	0xff, 0xfb, 0xf8, 0x00, 0xff, 0xf7, 0xf8, 0x00, 0xff, 0xe7, 0xf0, 0x00, 0xff, 0xdf, 0xe0, 0x00
};
// '0005', 32x64px
const unsigned char mainMenuAnimation_0005 [] PROGMEM = {
	0xff, 0x3f, 0xc0, 0x00, 0xff, 0x9f, 0xe0, 0x00, 0xff, 0xcf, 0xf0, 0x00, 0xff, 0xe7, 0xf0, 0x00, 
	0xff, 0xf7, 0xf8, 0x00, 0x3f, 0xfb, 0xfc, 0x00, 0x1f, 0xfd, 0xfc, 0x00, 0x0f, 0xfe, 0xfe, 0x00, 
	0x07, 0xff, 0x7f, 0x00, 0x03, 0xff, 0x3f, 0x00, 0x01, 0xff, 0xbf, 0x80, 0x00, 0xff, 0xdf, 0x80, 
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	0xff, 0xff, 0xf8, 0x00, 0xff, 0xf7, 0xf0, 0x00, 0xff, 0xef, 0xf0, 0x00, 0xff, 0xdf, 0xe0, 0x00
};
// '0006', 32x64px
const unsigned char mainMenuAnimation_0006 [] PROGMEM = {
	0xff, 0x3f, 0xc0, 0x00, 0xff, 0x9f, 0xe0, 0x00, 0xff, 0xcf, 0xf0, 0x00, 0xff, 0xe7, 0xf0, 0x00, 
	0xff, 0xf7, 0xf8, 0x00, 0x3f, 0xfb, 0xfc, 0x00, 0x1f, 0xfd, 0xfc, 0x00, 0x0f, 0xfe, 0xfe, 0x00, 
	0x07, 0xff, 0x7f, 0x00, 0x03, 0xff, 0x3f, 0x00, 0x01, 0xff, 0xbf, 0x80, 0x00, 0xff, 0xdf, 0x80, 
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	0xff, 0xfb, 0xf8, 0x00, 0xff, 0xf7, 0xf8, 0x00, 0xff, 0xe7, 0xf0, 0x00, 0xff, 0xdf, 0xe0, 0x00
};
// '0007', 32x64px
const unsigned char mainMenuAnimation_0007 [] PROGMEM = {
	0xff, 0x3f, 0xc0, 0x00, 0xff, 0x9f, 0xe0, 0x00, 0xff, 0xcf, 0xf0, 0x00, 0xff, 0xe7, 0xf0, 0x00, 
	0xff, 0xf7, 0xf8, 0x00, 0x3f, 0xfb, 0xfc, 0x00, 0xdf, 0xfd, 0xfc, 0x00, 0xef, 0xfe, 0xfe, 0x00, 
	0xe7, 0xff, 0x7f, 0x00, 0xc3, 0xff, 0x3f, 0x00, 0x81, 0xff, 0xbf, 0x80, 0x00, 0xff, 0xdf, 0x80, 
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	0xff, 0xff, 0xf8, 0x00, 0xff, 0xf7, 0xf0, 0x00, 0xff, 0xef, 0xf0, 0x00, 0xff, 0xdf, 0xe0, 0x00
};
// '0008', 32x64px
const unsigned char mainMenuAnimation_0008 [] PROGMEM = {
	0xff, 0x3f, 0xc0, 0x00, 0xff, 0x9f, 0xe0, 0x00, 0xff, 0xcf, 0xf0, 0x00, 0xff, 0xe7, 0xf0, 0x00, 
	0xff, 0xf7, 0xf8, 0x00, 0x3f, 0xfb, 0xfc, 0x00, 0xdf, 0xfd, 0xfc, 0x00, 0xef, 0xfe, 0xfe, 0x00, 
	0xf7, 0xff, 0x7f, 0x00, 0xfb, 0xff, 0x3f, 0x00, 0xf9, 0xff, 0xbf, 0x80, 0xf0, 0xff, 0xdf, 0x80, 
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	0xff, 0xfb, 0xf8, 0x00, 0xff, 0xf7, 0xf8, 0x00, 0xff, 0xe7, 0xf0, 0x00, 0xff, 0xdf, 0xe0, 0x00
};

// Array of all bitmaps for convenience. (Total bytes used to store images in PROGMEM = 2176)
const int mainMenuAnimation_allArray_LEN = 8;
const unsigned char* mainMenuAnimation_allArray[8] = {
	mainMenuAnimation_0001,
	mainMenuAnimation_0002,
	mainMenuAnimation_0003,
	mainMenuAnimation_0004,
	mainMenuAnimation_0005,
	mainMenuAnimation_0006,
	mainMenuAnimation_0007,
	mainMenuAnimation_0008
};

#pragma endregion

void previousItem()
{
    currentItemIndex--;
    if (currentItemIndex < 0)
    {
        currentItemIndex = numberOfItems - 1; // wrap around to the last item
    }
    previousItemIndex = currentItemIndex - 1;
    if (previousItemIndex < 0)
    {
        previousItemIndex = numberOfItems - 1; // wrap around to the last item
    }
    nextItemIndex = currentItemIndex + 1;
    if (nextItemIndex >= numberOfItems)
    {
        nextItemIndex = 0; // wrap around to the first item
    }
}

void nextItem()
{
    currentItemIndex++;
    if (currentItemIndex >= numberOfItems)
    {
        currentItemIndex = 0; // wrap around to the first item
    }
    nextItemIndex = currentItemIndex + 1;
    if (nextItemIndex >= numberOfItems)
    {
        nextItemIndex = 0; // wrap around to the first item
    }
    previousItemIndex = currentItemIndex - 1;
    if (previousItemIndex < 0)
    {
        previousItemIndex = numberOfItems - 1; // wrap around to the last item
    }
}

void innitIndices()
{
    nextItemIndex = currentItemIndex + 1;
    if (nextItemIndex >= numberOfItems)
    {
        nextItemIndex = 0; // wrap around to the first item
    }
    previousItemIndex = currentItemIndex - 1;
    if (previousItemIndex < 0)
    {
        previousItemIndex = numberOfItems - 1; // wrap around to the last item
    }
}

int currentFrame = 0;
int xoffset = 3;
unsigned long lastFrameTime = 0;
const unsigned long frameInterval = 50; // milliseconds between frames
void mainMenu()
{
    u8g2.clearBuffer();
    u8g2.setDrawColor(1);
    if(millis() - lastFrameTime >= frameInterval) {
        lastFrameTime = millis();
        currentFrame = (currentFrame + 1) % mainMenuAnimation_allArray_LEN;
    }
    u8g2.drawBitmap(-xoffset, 0, 32 / 8, 64, mainMenuAnimation_allArray[currentFrame]);
    u8g2.drawXBMP(30 - xoffset, 22, 97, 21, image_Select_bits);
    
    u8g2.drawBitmap(28 - xoffset, 2, 16 / 8, 16, Icons[previousItemIndex]);
    u8g2.setFont(u8g2_font_6x13_mf);
    u8g2.drawStr(48 - xoffset, 16, Icon_Names[previousItemIndex]);
    
    u8g2.drawBitmap(32 - xoffset, 24, 16 / 8, 16, Icons[currentItemIndex]);
    u8g2.setFont(u8g2_font_6x13B_tf);
    u8g2.drawStr(52 - xoffset, 37, Icon_Names[currentItemIndex]);
    
    u8g2.drawBitmap(28 - xoffset, 46, 16 / 8, 16, Icons[nextItemIndex]);
    u8g2.setFont(u8g2_font_6x13_mf);
    u8g2.drawStr(48 - xoffset, 59, Icon_Names[nextItemIndex]);

    
    u8g2.sendBuffer();
}