#include <U8g2lib.h>
#include <Arduino.h>
#include <buttonBehav.h>

extern U8G2_SSD1306_128X64_NONAME_F_HW_I2C u8g2;

#pragma region "Icons"
static const unsigned char image_Layer_6_bits[] U8X8_PROGMEM = {0x00, 0x00, 0x00, 0x00, 0xfe, 0xff, 0xff, 0x01, 0x00, 0x00, 0x00, 0x00, 0x00,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 0x00, 0x00};
static const unsigned char image_PressDown_bits[] U8X8_PROGMEM = {0x30, 0x00, 0x18, 0x00, 0x78, 0x00, 0x1c, 0x00, 0xf8, 0xff, 0x3f, 0x00, 0xf8,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 0xff, 0x00};
static const unsigned char image_PressLeft_bits[] U8X8_PROGMEM = {0x1c, 0x00, 0x00, 0x00, 0xff, 0x01, 0x00, 0x00, 0xff, 0x3f, 0x00, 0x00, 0xff,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 0x00, 0x00};
static const unsigned char image_PressRight_bits[] U8X8_PROGMEM = {0x00, 0x00, 0x80, 0x03, 0x00, 0x00, 0xf8, 0x0f, 0x00, 0xc0, 0xff, 0x0f, 0x00,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 0xc0, 0x07};
static const unsigned char image_PressUp_bits[] U8X8_PROGMEM = {0xf8, 0xff, 0xff, 0x00, 0xfe, 0xff, 0xff, 0x03, 0xff, 0xff, 0xff, 0x07, 0xff,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 0x60, 0x00};
#pragma endregion


void ButtonTest(int backValue, int maxBackValue)
{
    u8g2.clearBuffer();
    u8g2.setFontMode(1);
    u8g2.setBitmapMode(1);
    
    // Button Layout
    u8g2.drawXBMP(19, 9, 91, 53, image_Layer_6_bits);

    if(selectButtonHold()){
        // MiddlePress
        u8g2.drawFilledEllipse(64, 30, 10, 4);

    }

    if(rightButtonHold()){
        // PressRight
        u8g2.drawXBMP(80, 25, 28, 11, image_PressRight_bits);
    }
    
    if(leftButtonHold()){
        // PressLeft
        u8g2.drawXBMP(21, 25, 28, 11, image_PressLeft_bits);
    }

    if(upButtonHold()){
        // PressUp
        u8g2.drawXBMP(51, 11, 27, 14, image_PressUp_bits);
    }

    if(downButtonHold()){
        // PressDown
        u8g2.drawXBMP(52, 40, 27, 14, image_PressDown_bits);
    }
    
    u8g2.setFont(u8g2_font_4x6_tr);
    u8g2.drawStr(34, 6, "HOLD \"->\" to EXIT");

    u8g2.setDrawColor(2);
    int boxWidth = (backValue * 128)/maxBackValue;
    u8g2.drawBox(0, 0, boxWidth, 7);

    u8g2.sendBuffer();
}
