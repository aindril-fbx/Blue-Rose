#include <U8g2lib.h>
#include <Arduino.h>
#include <Wire.h>
#include <buttonBehav.h>

#if CONFIG_IDF_TARGET_ESP32
    // Classic ESP32
    extern U8G2_SSD1306_128X64_NONAME_F_HW_I2C u8g2;
    
#elif CONFIG_IDF_TARGET_ESP32C3
    // ESP32-C3
    extern U8G2_SH1106_128X64_NONAME_F_HW_I2C  u8g2;
#endif

# pragma region
static const unsigned char image_paused_1_bits[] U8X8_PROGMEM = {0xfc,0xff,0x01,0xfe,0xff,0x03,0xff,0xff,0x07,0xff,0xff,0x07,0x1f,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0xff,0x01};
static const unsigned char image_unpaused_bits[] U8X8_PROGMEM = {0xfc,0xff,0x01,0x02,0x00,0x02,0x01,0x00,0x04,0x01,0x00,0x04,0xe1,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0xff,0x01};
static const unsigned char image_unreset_bits[] U8X8_PROGMEM = {0xfc,0xff,0x01,0x02,0x00,0x02,0x01,0x00,0x04,0x01,0x00,0x04,0x81,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0xff,0x01};
static const unsigned char image_download_1_bits[] U8X8_PROGMEM = {0x08,0x0c,0x0e,0x0f,0x0e,0x0c,0x08};
static const unsigned char image_download_bits[] U8X8_PROGMEM = {0x01,0x03,0x07,0x0f,0x07,0x03,0x01};
# pragma endregion

unsigned long startTime = 0;
unsigned long elapsedTime = 0;

bool running = false;

void startStopWatch() {
    running = true;
    startTime = millis() - elapsedTime;
}

void pauseStopwatch() {
    elapsedTime = millis() - startTime;
    running = false;
}

void resetStopwatch() {
    elapsedTime = 0;
    startTime = millis() - elapsedTime;
}

extern int afkTime;

void Stopwatch() {
    afkTime = 0;
    if(rightButtonTap()) {
        if(running) {
            pauseStopwatch();
        } else {
            startStopWatch();
        }
    }
    if(leftButtonTap()) {
        resetStopwatch();
    }
    
    if(running) {
        elapsedTime = millis() - startTime;
    }

    u8g2.clearBuffer();
    u8g2.setFontMode(1);
    u8g2.setBitmapMode(1);

    // Layer 1
    String ms = String((elapsedTime % 1000)/10);
    unsigned long totalSeconds = elapsedTime / 1000;
    String hours = String((totalSeconds / 3600) % 100);
    String seconds = String(totalSeconds % 60);
    String minutes = String((totalSeconds / 60) % 60);
    String combinedTime;
    if(elapsedTime > 3600000){
        combinedTime = (hours.length() < 2 ? "0" + hours : hours) + ":" + (minutes.length() < 2 ? "0" + minutes : minutes) + ":" + (seconds.length() < 2 ? "0" + seconds : seconds);
    }else{
        combinedTime = (minutes.length() < 2 ? "0" + minutes : minutes) + ":" + (seconds.length() < 2 ? "0" + seconds : seconds) + "." + (ms.length() == 1 ? "0" + ms : ms);
    }

    u8g2.setFont(u8g2_font_profont22_tr);
    u8g2.drawStr(17, 26, combinedTime.c_str());

    // Layer 2
    u8g2.drawFrame(7, 6, 113, 27);

    if(running){
        u8g2.drawXBMP(77, 38, 19, 20, image_unpaused_bits);
    }else{
        u8g2.drawXBMP(77, 38, 19, 20, image_paused_1_bits);
    }
    // unreset
    u8g2.drawXBMP(31, 38, 19, 20, image_unreset_bits);

    // download
    u8g2.drawXBMP(109, 44, 4, 7, image_download_bits);

    // download
    u8g2.drawXBMP(14, 44, 4, 7, image_download_1_bits);

    u8g2.sendBuffer();
}
